## sf32lb52-nano_a128r16/blink/no-os/project/build_sf32lb52-nano_a128r16_hcpu/Kconfig
```kconfig
source "$SIFLI_SDK/Kconfig.v2"
source "$SIFLI_SDK/customer/boards/Kconfig.v2"
source "G:/OpenSiFli/SiFli-SDK/customer/boards/sf32lb52-nano_a128r16/hcpu/Kconfig.board"
source "C:/Users/C/Desktop/sf32lb52-nano_a128r16/blink/no-os/project/Kconfig.proj"
```

## sf32lb52-nano_a128r16/blink/no-os/project/build_sf32lb52-nano_a128r16_hcpu/ftab/Kconfig
```kconfig
source "$SIFLI_SDK/Kconfig.v2"
source "$SIFLI_SDK/customer/boards/Kconfig.v2"
source "G:/OpenSiFli/SiFli-SDK/customer/boards/sf32lb52-nano_a128r16/hcpu/Kconfig.board"
source "G:/OpenSiFli/SiFli-SDK/example/flash_table/sf32lb52x_common_v2/Kconfig.proj"
```

## sf32lb52-nano_a128r16/hello_world/rtt/project/Kconfig.tmp
```kconfig
source "G:/OpenSiFli/SiFli-SDK/customer/boards/sf32lb52-nano_a128r16/hcpu/Kconfig.board"
source "$SIFLI_SDK/customer/boards/Kconfig.v2"
source "$SIFLI_SDK/Kconfig.v2"
rsource "Kconfig.proj"
```

## sf32lb52-nano_a128r16/hello_world/rtt/project/build_sf32lb52-lcd_n16r8_hcpu/Kconfig
```kconfig
source "$SIFLI_SDK/Kconfig.v2"
source "$SIFLI_SDK/customer/boards/Kconfig.v2"
source "G:/OpenSiFli/SiFli-SDK/customer/boards/sf32lb52-lcd_n16r8/hcpu/Kconfig.board"
source "C:/Users/C/Desktop/hello_world/rtt/project/Kconfig.proj"
```

## sf32lb52-nano_a128r16/hello_world/rtt/project/build_sf32lb52-lcd_n16r8_hcpu/bootloader/Kconfig
```kconfig
source "$SIFLI_SDK/Kconfig.v2"
source "$SIFLI_SDK/customer/boards/Kconfig.v2"
source "G:/OpenSiFli/SiFli-SDK/customer/boards/sf32lb52-lcd_n16r8/hcpu/Kconfig.board"
source "G:/OpenSiFli/SiFli-SDK/example/boot_loader/project/butterflmicro/ram_v2/Kconfig.proj"
```

## sf32lb52-nano_a128r16/hello_world/rtt/project/build_sf32lb52-lcd_n16r8_hcpu/ftab/Kconfig
```kconfig
source "$SIFLI_SDK/Kconfig.v2"
source "$SIFLI_SDK/customer/boards/Kconfig.v2"
source "G:/OpenSiFli/SiFli-SDK/customer/boards/sf32lb52-lcd_n16r8/hcpu/Kconfig.board"
source "G:/OpenSiFli/SiFli-SDK/example/flash_table/sf32lb52x_common_v2/Kconfig.proj"
```

## sf32lb52-nano_a128r16/hello_world/rtt/project/build_sf32lb52-lchspi-ulp_hcpu/Kconfig
```kconfig
source "$SIFLI_SDK/Kconfig.v2"
source "$SIFLI_SDK/customer/boards/Kconfig.v2"
source "G:/OpenSiFli/SiFli-SDK/customer/boards/sf32lb52-lchspi-ulp/hcpu/Kconfig.board"
source "C:/Users/C/Desktop/hello_world/rtt/project/Kconfig.proj"
```

## sf32lb52-nano_a128r16/hello_world/rtt/project/build_sf32lb52-lchspi-ulp_hcpu/bootloader/Kconfig
```kconfig
source "$SIFLI_SDK/Kconfig.v2"
source "$SIFLI_SDK/customer/boards/Kconfig.v2"
source "G:/OpenSiFli/SiFli-SDK/customer/boards/sf32lb52-lchspi-ulp/hcpu/Kconfig.board"
source "G:/OpenSiFli/SiFli-SDK/example/boot_loader/project/butterflmicro/ram_v2/Kconfig.proj"
```

## sf32lb52-nano_a128r16/hello_world/rtt/project/build_sf32lb52-lchspi-ulp_hcpu/ftab/Kconfig
```kconfig
source "$SIFLI_SDK/Kconfig.v2"
source "$SIFLI_SDK/customer/boards/Kconfig.v2"
source "G:/OpenSiFli/SiFli-SDK/customer/boards/sf32lb52-lchspi-ulp/hcpu/Kconfig.board"
source "G:/OpenSiFli/SiFli-SDK/example/flash_table/sf32lb52x_common_v2/Kconfig.proj"
```

## sf32lb52-nano_a128r16/hello_world/rtt/project/build_sf32lb52-nano_a128r16_hcpu/bootloader/Kconfig
```kconfig
source "$SIFLI_SDK/Kconfig.v2"
source "$SIFLI_SDK/customer/boards/Kconfig.v2"
source "G:/OpenSiFli/SiFli-SDK/customer/boards/sf32lb52-nano_a128r16/hcpu/Kconfig.board"
source "G:/OpenSiFli/SiFli-SDK/example/boot_loader/project/butterflmicro/ram_v2/Kconfig.proj"
```
